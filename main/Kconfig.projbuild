## main/Kconfig.projbuild
```kconfig
menu "CAN Bridge Configuration"
    depends on SOC_TWAI_SUPPORTED

    orsource "$IDF_PATH/examples/common_components/env_caps/$IDF_TARGET/Kconfig.env_caps"

    config CAN_TX_GPIO
        int "CAN TX GPIO"
        default 4
        help
            GPIO pin for CAN TX signal.

    config CAN_RX_GPIO
        int "CAN RX GPIO"
        default 5
        help
            GPIO pin for CAN RX signal.

endmenu
```

## sdkconfig.defaults
```kconfig
# USB CDC Console Configuration
CONFIG_ESP_CONSOLE_USB_CDC=y
CONFIG_ESP_CONSOLE_SECONDARY_NONE=y

# CAN GPIO Configuration
CONFIG_CAN_TX_GPIO=4
CONFIG_CAN_RX_GPIO=5

# Increase USB CDC buffer sizes for better throughput
CONFIG_USB_CDC_RX_BUFSIZE=256
CONFIG_USB_CDC_TX_BUFSIZE=256

# Enable USB Serial JTAG for targets that support it
# (will be used automatically if USB CDC is not available)
```
